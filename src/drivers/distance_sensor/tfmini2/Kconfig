## src/drivers/distance_sensor/tfmini2/Kconfig
```kconfig
menuconfig DRIVERS_DISTANCE_SENSOR_TFMINI2
	bool "tfmini2"
	default n
	---help---
		Enable support for tfmini
```

## src/drivers/distance_sensor/tfmini_forward/Kconfig
```kconfig
menuconfig DRIVERS_DISTANCE_SENSOR_TFMINI_FORWARD
	bool "tfmini_forward"
	default n
	---help---
		Enable support for tfmini_forward
```

## src/modules/xt_lora/Kconfig
```kconfig
menuconfig MODULES_XT_LORA
	bool "xt_lora"
	default n
	---help---
		Enable support for xt_lora
```

## src/modules/xt_pro/Kconfig
```kconfig
menuconfig MODULES_XT_PRO
	bool "xt_pro"
	default n
	---help---
		Enable support for xt_pro
```

## src/modules/xt_project/Kconfig
```kconfig
menuconfig MODULES_XT_PROJECT
	bool "xt_project"
	default n
	---help---
		Enable support for xt_project
```
